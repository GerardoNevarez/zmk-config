## config/boards/shields/gerrypad/Kconfig.defconfig
```kconfig
# Copyright (c) 2020 Pete Johanson, Richard Jones
# SPDX-License-Identifier: MIT

if SHIELD_GERRYPAD

config ZMK_KEYBOARD_NAME
	default "GerryPad"

endif
```

## config/boards/shields/gerrypad/Kconfig.shield
```kconfig
# Copyright (c) 2020 Pete Johanson, Richard Jones
# SPDX-License-Identifier: MIT

config SHIELD_GERRYPAD
	def_bool $(shields_list_contains,gerrypad)
```

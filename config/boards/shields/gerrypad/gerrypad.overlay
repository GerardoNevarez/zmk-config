/*
 * Copyright (c) 2020 Pete Johanson, Richard Jones
 *
 * SPDX-License-Identifier: MIT
 */

#include <dt-bindings/zmk/matrix_transform.h>

/ {
	chosen {
		zmk,kscan = &kscan0;
	};

	kscan0: kscan {
		compatible = "zmk,kscan-gpio-matrix";
		label = "KSCAN";

		diode-direction = "row2col";
		row-gpios
			= <&gpio1  6 GPIO_ACTIVE_HIGH>
			, <&gpio1  4 GPIO_ACTIVE_HIGH>
			, <&gpio0 11 GPIO_ACTIVE_HIGH>
			, <&gpio1  0 GPIO_ACTIVE_HIGH>
			, <&gpio0 24 GPIO_ACTIVE_HIGH>
			;

		col-gpios
			= <&gpio0 22 (GPIO_ACTIVE_HIGH | GPIO_PULL_DOWN)>
			, <&gpio0 17 (GPIO_ACTIVE_HIGH | GPIO_PULL_DOWN)>
			, <&gpio0  8 (GPIO_ACTIVE_HIGH | GPIO_PULL_DOWN)>
			, <&gpio0  6 (GPIO_ACTIVE_HIGH | GPIO_PULL_DOWN)>
			;

	};
};

